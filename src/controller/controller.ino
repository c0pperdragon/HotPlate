// Program running on an ATTiny1604, 16MHz, disable millis/micros timer

#include <Wire.h>
#include <EEPROM.h>
#include "oled.h"

// -- defining pins
#define ACTIVATE_TOP     PIN_PB2
#define ACTIVATE_BOTTOM  PIN_PA6   
#define SELECTOR         PIN_PA4
#define ONOFF            PIN_PA3
#define SENSE_VOLTAGE    PIN_PA5
#define SENSE_CURRENT    PIN_PA7

// -- state of the hardware
volatile bool standby = true;
volatile int tempset = 0;  // in celsius
volatile int tempcur = 0;  // in celsius
volatile int voltage = 0;  // in mV
volatile int current = 0;  // in mA
volatile int duty = 0;     // in percent
volatile byte fahrenheit = false;

int phase = 0;    // runs from 0 to 99
bool activate_top = false;
bool activate_bottom = false;
unsigned long sum_current = 0;
unsigned long sum_voltage = 0;
unsigned long samples_taken = 0;
int onoff_presstime = 0;
int runningtime = 0;
boolean autofinish = false;
int hightemperaturetime = 0;
 
// -- configure pins and set up interrupt
void setup() 
{
  pinMode(ACTIVATE_TOP, OUTPUT);
  digitalWrite(ACTIVATE_TOP, LOW);
  pinMode(ACTIVATE_BOTTOM, OUTPUT);
  digitalWrite(ACTIVATE_BOTTOM, LOW);
  pinMode(SELECTOR, INPUT);
  pinMode(ONOFF, INPUT_PULLUP);
  pinMode(SENSE_VOLTAGE, INPUT);
  pinMode(SENSE_CURRENT, INPUT);

  Wire.begin(); 
  Wire.setClock(50000);

  TCA0.SINGLE.INTCTRL = 0x00;  // disable TCA0 interrupts
  TCA0.SINGLE.CTRLA = 0x01;          // enable timer at full speed
  TCA0.SINGLE.CTRLB = 0x00;          // normal counting mode
  TCA0.SINGLE.CTRLC = 0x00;          // no timer output on pins
  TCA0.SINGLE.CTRLD = 0x00;          // disable split mode (use single mode)
  TCA0.SINGLE.CTRLECLR = 0x03;       // normal register update, counting up
  TCA0.SINGLE.EVCTRL = 0x00;         // no event couting                
  TCA0.SINGLE.CNT = 0;
  TCA0.SINGLE.PER = 16000;
  TCA0.SINGLE.INTCTRL = 0x01;        // enable timer overflow interrupt 

  fahrenheit = EEPROM.read(0) != 255;
}

// -------------- interrupt running with 1 ms interval to control everything -------------
ISR (TCA0_OVF_vect) {
  TCA0.SINGLE.INTFLAGS = 0x01;        // clear interrupt flag
  phase = phase<99 ? phase+1 : 0;     // cycle phase

  // handle the on-off button
  byte onoff = digitalRead(ONOFF);
  if (onoff==HIGH)
  {
    onoff_presstime = 0;
  }
  else if (onoff_presstime < 32000)
  {
    onoff_presstime++;
  }
  if (onoff_presstime == 20)  // toggle standby after 20 ms button press
  {
    // doing a second press after start turns on auto-finish
    if ((!standby) && runningtime<1000) 
    {
        autofinish=true;
    }
    else
    {
      standby = !standby; 
      autofinish = false;
      hightemperaturetime = 0;
      if (standby)
      { 
        activate_top = false;
        activate_bottom = false;
        digitalWrite(ACTIVATE_TOP, LOW);
        digitalWrite(ACTIVATE_BOTTOM, LOW);
      }
      else
      {
        duty = 1;
      }
    }
  }
  if (onoff_presstime == 3000)   // toggle fahrenheit/celsius after 3 seconds
  {
    fahrenheit = ! fahrenheit;
    EEPROM.write(0, fahrenheit ? 0 : 255); 
  }
  if (onoff_presstime == 0 && autofinish && hightemperaturetime>10)
  {
      standby = true; 
      activate_top = false;
      activate_bottom = false;
      digitalWrite(ACTIVATE_TOP, LOW);
      digitalWrite(ACTIVATE_BOTTOM, LOW);
  }
    
  // do nothing else in standby
  if (standby) 
  { 
     runningtime=0; 
     return; 
  }
  // measure time since start of machine
  else if (runningtime<32000) {
    runningtime = runningtime+1;
  }
  
  tempset = 227 - (analogRead(SELECTOR) >> 3);

  if (activate_top)
  {
    int c = analogRead(SENSE_CURRENT);
    int v = analogRead(SENSE_VOLTAGE);
    sum_current += (c>=512) ? c-512 : 0;
    sum_voltage += v;
    samples_taken++;    
  }
  if (phase==0) 
  {
    voltage = (int) ( (sum_voltage * 12000) / (samples_taken * 767) );      // in millivolt
    current = (int) ( (sum_current * 1000) / (samples_taken * 81) );        // in milliampere
    int resistance = (int) ( (((long)voltage) * 1000) / current );          // in milliohm
    tempcur = 20 + (resistance-3600) / 16;                                  // in centigrade
    if (tempcur<0) { tempcur=0; }
    sum_current = 0;
    sum_voltage = 0;
    samples_taken=0;

    int power = 1300 + (tempset-155) * 10;    // in 100th watt  - estimated by experiment   
    duty = ((1000000L / current) * power) / voltage;
    if (tempcur>=tempset) 
    { 
        duty=0; 
        if (hightemperaturetime<32000) { hightemperaturetime++; }
    }       
    if (duty<5) duty=5;
    if (duty>99) duty=99;
    if (duty>50 && current>2200) { duty=50; }
  }

  int phase2 = phase<50 ? phase+50 : phase-50;
  activate_top = (phase >= 100-duty);
  activate_bottom = (phase2 >= 100-duty);
  if (!activate_top) digitalWrite(ACTIVATE_TOP, LOW);
  if (!activate_bottom) digitalWrite(ACTIVATE_BOTTOM, LOW);
  if (activate_top) digitalWrite(ACTIVATE_TOP, HIGH);
  if (activate_bottom) digitalWrite(ACTIVATE_BOTTOM, HIGH);
}

// -------------------------- handling the display ----------------------------------------

OLED display(Wire, 0x3C, NO_RESET_PIN, 1, 64, true);

bool vis_standby = false;
int vis_tempset = -1;
int vis_tempcur = -1;
int vis_voltage = -1;
int vis_current = -1;
int vis_duty = -1;
bool vis_fahrenheit = false;
bool vis_autofinish = false;

const byte background[(128/8) * 64] = {
  B00000000,B00000000,B00000000,B00000000,B00000000,B00000000,B00000000,B00000000,B00000000,B00000000,B00000000,B00000000,B00000000,B00000000,B00000000,B00000000,
  B00000000,B00000000,B00000000,B00000000,B00000000,B00000000,B00000000,B00000000,B00000000,B00000000,B00000000,B00000000,B00000000,B00000000,B11110000,B00000000,
  B00000000,B00000000,B00000000,B00000000,B00000000,B00000000,B00000000,B00000000,B00000000,B00000000,B00000000,B00000000,B00000000,B00000001,B10011000,B00000000,
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  B00000000,B00000000,B00000000,B00000000,B00000000,B00000000,B00000000,B00000000,B00000000,B00000000,B00000000,B00000000,B00000000,B00000000,B00000000,B00000000,
};

const byte bigdigits[(10*2) * 28] = {
  B00000000,B00000000, B00000000,B00000000, B00000000,B00000000, B00000000,B00000000, B00000000,B00000000, B00000000,B00000000, B00000000,B00000000, B00000000,B00000000, B00000000,B00000000, B00000000,B00000000,
  B00000000,B00000000, B00000000,B00000000, B00000000,B00000000, B00000000,B00000000, B00000000,B00000000, B00000000,B00000000, B00000000,B00000000, B00000000,B00000000, B00000000,B00000000, B00000000,B00000000,
  B00000000,B00000000, B00000000,B00000000, B00000000,B00000000, B00000000,B00000000, B00000000,B00000000, B00000000,B00000000, B00000000,B00000000, B00000000,B00000000, B00000000,B00000000, B00000000,B00000000,
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  B00000000,B00000000, B00000000,B00000000, B00000000,B00000000, B00000000,B00000000, B00000000,B00000000, B00000000,B00000000, B00000000,B00000000, B00000000,B00000000, B00000000,B00000000, B00000000,B00000000,
};

const byte smalldigits[(12) * 20] = {
  B00000000, B00000000, B00000000, B00000000, B00000000, B00000000, B00000000, B00000000, B00000000, B00000000, B00000000, B00000000,  
  B00000000, B00000000, B00000000, B00000000, B00000000, B00000000, B00000000, B00000000, B00000000, B00000000, B00000000, B00000000, 
  B00000000, B00000000, B00000000, B00000000, B00000000, B00000000, B00000000, B00000000, B00000000, B00000000, B00000000, B00000000, 
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  B00000000, B00000000, B00000000, B00000000, B00000000, B00000000, B00000000, B00000000, B00000000, B00000000, B00000000, B00000000, 
};

void big_number(int x, int page, int vshift, int value, int digits)
{
  for (int p=digits-1; p>=0; p--)
  {
    int v = value/10;
    int d = value - v*10;
    value = v;
    display.direct(x+p*20, page, 16, 3, bigdigits+(d*2+vshift*10*2), 10*2);
  }
}

void small_number(int x, int page, int value, int digits)
{
  for (int p=digits-1; p>=0; p--)
  {
    int v = value/10;
    int d = value - v*10;
    value = v;
    display.direct(x+p*10, page, 8, 2, smalldigits+d, 12);
  }
}

void loop() 
{
  bool b;
  int v;
  
  noInterrupts(); b = standby; interrupts();
  if (b!=vis_standby) 
  {
    vis_standby = b;
    if (vis_standby) 
    {
      display.set_power(false);
    }
    else 
    {
      display.init();
      display.rotate_180(true);
      display.direct(0,0,128,8,background,16);
      vis_tempset = -1;
      vis_tempcur = -1;
      vis_voltage = -1;
      vis_current = -1;
      vis_duty = -1;
      vis_fahrenheit = ! fahrenheit;
    }
  }
  
  noInterrupts(); b = fahrenheit; interrupts();
  if (b!=vis_fahrenheit) 
  {
    vis_fahrenheit = b;
    vis_tempset = -1;
    vis_tempcur = -1;
    int d =  b ? 11 : 10;
    display.direct(120, 0, 8, 2, smalldigits+d + 3*12, 12);
    display.direct(120, 3, 8, 2, smalldigits+d, 12);
  }
  
  noInterrupts(); v = tempset; interrupts();
  if (v!=vis_tempset)  // v<vis_tempset-1 || v>vis_tempset) 
  {
    vis_tempset = v;
    big_number(48,0,3, fahrenheit ? 32 + v*9/5 :v, 3);
  }

  noInterrupts(); v = tempcur; interrupts();
  if (v<vis_tempcur-1 || v>vis_tempcur) 
  {
    vis_tempcur = v;
    big_number(48,3,0, fahrenheit ? 32 + v*9/5 :v, 3);
  }

  noInterrupts(); v = duty; interrupts();
  if (v!=vis_duty) 
  {
    vis_duty = v;
    if (v>5) {
      small_number(0,6,v,2);
    }
    else {
      display.direct(0, 6, 20, 1, background, 1);
      display.direct(0, 7, 20, 1, background, 1);
    }
  }

  noInterrupts(); v = voltage/10; interrupts();
  if (v!=vis_voltage) 
  {
    vis_voltage = v;
    small_number(25,6,v/100,2);
    small_number(48,6,v%100,2);
  }
  
  noInterrupts(); v = current; interrupts();
  if (v!=vis_current) 
  {
    vis_current = v;
    small_number(82,6,v/1000,1);
    small_number(95,6,v%1000,3);
  }
  
  noInterrupts(); b = autofinish; interrupts();
  if (b!=vis_autofinish) 
  {
    vis_autofinish = b;
    display.direct(0,  0, 8, 2, smalldigits+0  + 1*12, 12);
    display.direct(10, 0, 8, 2, smalldigits+11 + 1*12, 12);
    display.direct(20, 0, 8, 2, smalldigits+11 + 1*12, 12);
  }
}
    
